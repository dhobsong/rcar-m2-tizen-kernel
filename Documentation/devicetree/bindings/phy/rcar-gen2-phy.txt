## Documentation/devicetree/bindings/phy/rcar-gen2-phy.txt
```
* Renesas R-Car generation 2 USB PHY

This file provides information on what the device node for the R-Car generation
2 USB PHY contains.

Required properties:
- compatible: "renesas,usb-phy-r8a7790" if the device is a part of R8A7790 SoC.
	      "renesas,usb-phy-r8a7791" if the device is a part of R8A7791 SoC.
- reg: offset and length of the register block.
- #phy-cells: see phy-bindings.txt in the same directory, must be 2.
- clocks: clock phandle and specifier pair.
- clock-names: string, clock input name, must be "usbhs".

The phandle's first argument in the PHY specifier identifies the USB channel,
the second one is the USB controller selector and depends on the first:

+-----------+---------------+---------------+
|\ Selector |               |               |
+ --------- +       0       |       1       |
| Channel  \|               |               |
+-----------+---------------+---------------+
| 0         | PCI EHCI/OHCI | HS-USB        |
| 1         | PCI EHCI/OHCI | xHCI          |
+-----------+---------------+---------------+

The USB PHY device tree node should be the subnodes corresponding to the USB
channels and the controllers connected to them. These subnodes must contain the
following properties:
- renesas,phy-select: the first cell identifies the USB channel, the second cell
  is the USB controller selector; see the table above for the values.
- renesas,ugctrl2-masks: the first cell is the UGCTRL2 mask corresponding to
  the USB channel, the second cell is the UGCTRL2 value corresponding to the
  USB controller selected for that channel.

Example (Lager board):

	usb-phy@e6590100 {
		compatible = "renesas,usb-phy-r8a7790";
		reg = <0 0xe6590100 0 0x100>;
		#phy-cells = <2>;
		clocks = <&mstp7_clks R8A7790_CLK_HSUSB>;
		clock-names = "usbhs";

		usb-phy@0,0 {
			renesas,phy-select = <0 0>;
			renesas,ugctrl2-masks = <0x00000030 0x00000010>;
		};
		usb-phy@0,1 {
			renesas,phy-select = <0 1>;
			renesas,ugctrl2-masks = <0x00000030 0x00000030>;
		};
		usb-phy@1,0 {
			renesas,phy-select = <1 0>;
			renesas,ugctrl2-masks = <0x80000000 0x00000000>;
		};
		usb-phy@1,1 {
			renesas,phy-select = <1 1>;
			renesas,ugctrl2-masks = <0x80000000 0x80000000>;
		};
	};
```

## drivers/gpu/drm/i2c/Kconfig
```kconfig
menu "I2C encoder or helper chips"
     depends on DRM && DRM_KMS_HELPER && I2C

config DRM_I2C_CH7006
	tristate "Chrontel ch7006 TV encoder"
	default m if DRM_NOUVEAU
	help
	  Support for Chrontel ch7006 and similar TV encoders, found
	  on some nVidia video cards.

	  This driver is currently only useful if you're also using
	  the nouveau driver.

config DRM_I2C_SIL164
	tristate "Silicon Image sil164 TMDS transmitter"
	default m if DRM_NOUVEAU
	help
	  Support for sil164 and similar single-link (or dual-link
	  when used in pairs) TMDS transmitters, used in some nVidia
	  video cards.

config DRM_I2C_NXP_TDA998X
	tristate "NXP Semiconductors TDA998X HDMI encoder"
	default m if DRM_TILCDC
	help
	  Support for NXP Semiconductors TDA998X HDMI encoders.

config DRM_ADV7511
	tristate "ADV7511 encoder"
	select REGMAP_I2C
	select HDMI
	help
	  Choose this option if you want to select ADV7511
	  encoder
	  If you want to use ADV7511, you select y.
	  If you don't want to use ADV7511, you select n.

config DRM_ADV7511_DVI_OUTPUT
	bool "ADV7511 DVI output mode"
	depends on DRM_ADV7511
	help
	  Choose this option if you want to select DVI mode for
	  ADV7511 encoder.
	  If you want to use DVI mode, you select y.
	  If you want to use HDMI mode, you select n.

endmenu
```

## drivers/gpu/drm/rcar-du/Kconfig
```kconfig
config DRM_RCAR_DU
	tristate "DRM Support for R-Car Display Unit"
	depends on DRM && ARM
	select DRM_KMS_HELPER
	select DRM_KMS_CMA_HELPER
	select DRM_GEM_CMA_HELPER
	help
	  Choose this option if you have an R-Car chipset.
	  If M is selected the module will be called rcar-du-drm.

config DRM_RCAR_LVDS
	bool "R-Car DU LVDS Encoder Support"
	depends on DRM_RCAR_DU
	help
	  Enable support the R-Car Display Unit embedded LVDS encoders
	  (currently only on R8A7790).

config DRM_RCAR_DESKTOP_TURN_OFF
	bool "R-Car DU turn off desktop layer"
	depends on DRM_RCAR_DU
	default n
	help
	  Choose this option if you want to turn off desktop layer.

	  If you want to turn off desktop layer, you select y.
	  If you want to turn on desktop layer, you select n.
```

## drivers/pci/host/Kconfig
```kconfig
menu "PCI host controller drivers"
	depends on PCI

config PCI_RCAR_GEN2
	bool "Renesas R-Car Gen2 Internal PCI controller"
	depends on ARCH_SHMOBILE || (ARM && COMPILE_TEST)
	select GENERIC_ALLOCATOR
	select DMABOUNCE
	select BOUNCE if HIGHMEM
	help
	  Say Y here if you want internal PCI support on R-Car Gen2 SoC.
	  There are 3 internal PCI controllers available with a single
	  built-in EHCI/OHCI host controller present on each one.

endmenu
```

## drivers/phy/Kconfig
```kconfig
#
# PHY
#

menu "PHY Subsystem"

config GENERIC_PHY
	bool "PHY Core"
	help
	  Generic PHY support.

	  This framework is designed to provide a generic interface for PHY
	  devices present in the kernel. This layer will have the generic
	  API by which phy drivers can create PHY using the phy framework and
	  phy users can obtain reference to the PHY. All the users of this
	  framework should select this config.

config PHY_RCAR_GEN2
	tristate "Renesas R-Car generation 2 USB PHY driver"
	depends on ARCH_SHMOBILE
	depends on GENERIC_PHY
	help
	  Support for USB PHY found on Renesas R-Car generation 2 SoCs.

endmenu
```
